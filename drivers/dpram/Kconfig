## drivers/dpram/Kconfig
```kconfig
# Dpram configuration
#

menu "Dpram support"

config DPRAM
       tristate "Using smem as dpram"
	   depends on MACH_TREBON || MACH_AMAZING_CDMA
       ---help---
		Include this for using smem as dpram for communication between modem and appl.
config DPRAM_WHITELIST
       bool "Using dpram to send whitelist port infos"
	   depends on MACH_TREBON
       ---help---
		Include this for using whitelist.

endmenu
```

## drivers/sensors/Kconfig
```kconfig
# 
# Sensors core device. 
#

config SENSORS_CORE
	tristate "Sensors core"
	default n
	help
	  Say Y here to enable debugging messages for power supply class
	  and drivers.

config SENSORS_ALPS
	tristate "Sensors Alps"
	default n
	help
	  Say Y here to enable debugging messages for power supply class
	  and drivers.

config SENSORS_HSCD
	depends on I2C
	tristate "hscd alps mag"
	default n
	help
	  This option enables hscd alps mag and bma222 accel driver.
	  
config SENSORS_BMA222
	depends on I2C
	tristate "bma222 accel"
	default n
	help
	  This option enables hscd alps mag and bma222 accel driver.
	  
config SENSORS_BMA222E
	depends on I2C
	tristate "bma222e accel"
	default n
	help
	  This option enables hscd alps mag and bma222 accel driver.

config PROXIMITY_SENSOR
	tristate "proximity_sensor"
	default n
	help
	  This option enables magnetic sensors using mmc328x magnetic driver.

config USE_BMA_INITLIB
    tristate "bma init lib"
    default n
    depends on I2C
    help
      This option enable bma sensor using init code for i2c communication.
```
